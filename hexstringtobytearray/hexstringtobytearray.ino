#include <string.h>
#include <SPI.h>
#include <Wire.h>
#include <Adafruit_GFX.h>
#include <Adafruit_SSD1306.h>

#define SCREEN_WIDTH 128 // OLED display width, in pixels
#define SCREEN_HEIGHT 64 // OLED display height, in pixels

// Declaration for an SSD1306 display connected to I2C (SDA, SCL pins)
// The pins for I2C are defined by the Wire-library. 
// On an arduino UNO:       A4(SDA), A5(SCL)
// On an arduino MEGA 2560: 20(SDA), 21(SCL)
// On an arduino LEONARDO:   2(SDA),  3(SCL), ...
#define OLED_RESET     -1 // Reset pin # (or -1 if sharing Arduino reset pin)
#define SCREEN_ADDRESS 0x3D ///< See datasheet for Address; 0x3D for 128x64, 0x3C for 128x32
Adafruit_SSD1306 display(SCREEN_WIDTH, SCREEN_HEIGHT, &Wire, OLED_RESET);

// Sample input string of hex values
String hexString = "0xff,0xff,0xff,0xff,0xff,0xff,0xff,0xff,0xff,0xff,0xff,0xff,0xff,0xff,0xff,0xff,0xff,0xff,0xff,0xff,0xff,0xff,0xff,0xff,0xff,0xff,0xff,0xff,0xff,0xff,0xff,0xff,0xff,0xff,0xff,0xff,0xff,0xff,0xff,0xff,0xff,0xff,0xff,0xff,0xff,0xff,0xff,0xff,0xff,0xff,0xff,0xff,0xff,0xff,0xff,0xff,0xff,0xff,0xff,0xff,0xff,0xff,0xff,0xff,0xff,0xff,0xff,0xff,0xff,0xff,0xff,0xff,0xff,0xff,0xff,0xff,0xff,0xff,0xff,0xff,0xff,0xff,0xff,0xff,0xff,0xff,0xff,0xff,0xff,0xff,0xff,0xff,0xff,0xff,0xff,0xff,0xff,0xff,0xff,0xff,0xff,0xff,0xff,0xff,0xff,0xff,0xff,0xff,0xff,0xff,0xff,0xff,0xff,0xff,0xff,0xff,0xff,0xff,0xff,0xff,0xff,0xff,0xff,0xff,0xff,0xff,0xff,0xff,0xff,0xff,0xff,0xff,0xff,0xff,0xff,0xff,0xff,0xff,0xff,0xff,0xff,0xff,0xff,0xff,0xff,0xff,0xff,0xff,0xff,0xff,0xff,0xff,0xff,0xff,0xff,0xff,0xff,0xff,0xff,0xff,0xff,0xff,0xff,0xff,0xff,0xff,0xff,0xff,0xff,0xff,0xff,0xff,0xff,0xff,0xff,0xff,0xff,0xff,0xff,0xff,0xff,0xff,0xff,0xff,0xff,0xff,0xff,0xff,0xff,0xff,0xff,0xff,0xff,0xff,0xff,0xff,0xff,0xff,0xff,0xff,0xff,0xff,0xff,0xff,0xff,0xff,0xff,0xff,0xff,0xff,0xff,0xff,0xff,0xff,0xff,0xff,0xff,0xff,0xff,0xff,0xff,0xff,0xff,0xff,0xff,0xff,0xff,0xff,0xff,0xff,0xff,0xff,0xff,0xff,0xff,0xff,0xff,0xff,0xff,0xff,0xff,0xff,0xff,0xff,0xff,0xff,0xff,0xff,0xff,0xff,0xff,0xff,0xff,0xff,0xff,0xff,0xff,0xff,0xff,0xff,0xff,0xff,0xc0,0xff,0xff,0xff,0xe0,0x03,0xff,0xff,0xff,0xff,0xff,0xff,0xff,0xff,0xff,0xff,0x00,0x3f,0xff,0xff,0x81,0xc0,0xff,0xff,0xff,0xff,0xff,0xff,0xff,0xff,0xff,0xfe,0x3f,0x0f,0xff,0xfe,0x00,0xf0,0xff,0xff,0xff,0xff,0xff,0xff,0xff,0xff,0xff,0xfc,0xff,0xc7,0xff,0xf8,0x00,0x01,0xff,0xff,0xff,0xff,0xff,0xff,0xff,0xff,0xff,0xf8,0xff,0xe7,0xff,0xe1,0xf8,0x0f,0xff,0xff,0xff,0xff,0xff,0xff,0xff,0xff,0xff,0xe3,0xff,0xf3,0xff,0xc7,0xfe,0x3f,0xff,0xff,0xff,0xff,0xff,0xff,0xff,0xff,0xff,0x07,0xff,0xf9,0xff,0xc3,0xff,0x3f,0xff,0xff,0xff,0xff,0xff,0xff,0xff,0xff,0xf0,0x0f,0xff,0xf9,0xff,0x83,0xff,0x93,0xff,0xff,0xff,0xff,0xff,0xff,0xff,0xff,0xc1,0xff,0xff,0xf0,0xff,0x83,0xff,0xc1,0xff,0xff,0xff,0xff,0xff,0xff,0xff,0xff,0x0f,0xff,0xff,0xc0,0x7f,0x87,0xff,0xc4,0xff,0xff,0xff,0xff,0xff,0xff,0xff,0xfe,0x3f,0xf3,0xff,0xc0,0x7f,0x87,0xff,0xcc,0x7f,0xff,0xff,0xff,0xff,0xff,0xff,0xfc,0xff,0xf3,0xff,0x80,0x7f,0x0f,0xff,0xce,0x7f,0xff,0xff,0xff,0xff,0xff,0xff,0xf9,0xff,0xf9,0xfe,0x00,0x7f,0x0f,0xff,0xef,0x3f,0xff,0xff,0xff,0xff,0xff,0xff,0xf3,0xff,0xfd,0xfe,0x00,0x3e,0x1e,0x3f,0xff,0x3f,0xff,0xff,0xff,0xff,0xff,0xff,0xf7,0xff,0xff,0xfc,0x00,0x3c,0x38,0x1f,0xff,0x3f,0xff,0xff,0xff,0xff,0xff,0xff,0xe7,0xff,0xff,0xfc,0x00,0x3c,0x70,0xcf,0xff,0x3f,0xff,0xff,0xff,0xff,0xff,0xff,0xe7,0xff,0xff,0xfc,0x00,0x01,0xf3,0xe7,0xff,0x0f,0xff,0xff,0xff,0xff,0xff,0xff,0xe7,0xff,0xff,0xf8,0x00,0x03,0xf1,0xe7,0xff,0x87,0xff,0xff,0xff,0xff,0xff,0xff,0xc7,0xff,0xff,0xf8,0x00,0x1f,0xe1,0xf7,0xff,0xe3,0xff,0xff,0xff,0xff,0xff,0xff,0x87,0xff,0xff,0xf8,0x00,0x3f,0xe7,0xf3,0xf7,0xe3,0xff,0xff,0xff,0xff,0xff,0xff,0x07,0xff,0xff,0xf8,0x00,0x38,0x03,0xf3,0xe3,0xf1,0xff,0xff,0xff,0xff,0xff,0xff,0x07,0xff,0xff,0xf0,0x00,0x78,0x03,0xf3,0xe3,0xe3,0xff,0xff,0xff,0xff,0xff,0xff,0x01,0xff,0xff,0xf8,0x00,0x7f,0xff,0xf7,0xe1,0xe3,0xff,0xff,0xff,0xff,0xff,0xff,0x00,0xff,0xff,0xf8,0x00,0x7f,0xff,0xf3,0xc8,0xe3,0xff,0xff,0xff,0xff,0xff,0xff,0x80,0x1f,0xe0,0x78,0x00,0x7f,0xff,0xc0,0x00,0x00,0x3f,0xff,0xff,0xff,0xff,0xf8,0x00,0x00,0x00,0x00,0x00,0x00,0x00,0x00,0x00,0x00,0x3f,0xff,0xff,0xff,0xff,0xf8,0x00,0x00,0x00,0x00,0x00,0x00,0x00,0x1f,0xff,0xff,0xff,0xff,0xff,0xff,0xff,0xff,0xff,0xff,0xff,0xfe,0x1f,0xff,0xff,0x7f,0xff,0xff,0xff,0xff,0xff,0xff,0xff,0xff,0xff,0xff,0xff,0xff,0xff,0xff,0xff,0xff,0xff,0xff,0xff,0xff,0xff,0xff,0xff,0xff,0xff,0xff,0xff,0xff,0xff,0xff,0xff,0xff,0xff,0xff,0xff,0xff,0xff,0xff,0xff,0xff,0xff,0xff,0xff,0xff,0xff,0xff,0xff,0xff,0xff,0xff,0xff,0xff,0xff,0xff,0xff,0xff,0xff,0xff,0xff,0xff,0xff,0xff,0xff,0xff,0xff,0xff,0xff,0xff,0xff,0xff,0xff,0xff,0xff,0xff,0xff,0xff,0xff,0xff,0xff,0xff,0xff,0xff,0xff,0xff,0xff,0xff,0xff,0xff,0xff,0xff,0xff,0xff,0xff,0xff,0xff,0xff,0xff,0xff,0xff,0xff,0xff,0xff,0xff,0xff,0xff,0xff,0xff,0xff,0xff,0xff,0xff,0xff,0xff,0xff,0xff,0xff,0xff,0xff,0xff,0xff,0xff,0xff,0xff,0xff,0xff,0xff,0xff,0xff,0xff,0xff,0xff,0xff,0xff,0xff,0xff,0xff,0xff,0xff,0xff,0xff,0xff,0xff,0xff,0xff,0xff,0xff,0xff,0xff,0xff,0xff,0xff,0xff,0xff,0xff,0xff,0xff,0xff,0xff,0xff,0xff,0xff,0xff,0xff,0xff,0xff,0xff,0xff,0xff,0xff,0xff,0xff,0xff,0xff,0xff,0xff,0xff,0xff,0xff,0xff,0xff,0xff,0xff,0xff,0xff,0xff,0xff,0xff,0xff,0xff,0xff,0xff,0xff,0xff,0xff,0xff,0xff,0xff,0xff,0xff,0xff,0xff,0xff,0xff,0xff,0xff,0xff,0xff,0xff,0xff,0xff,0xff,0xff,0xff,0xff,0xff,0xff,0xff,0xff,0xff,0xff,0xff,0xff,0xff,0xff,0xff,0xff,0xff,0xff,0xff,0xff,0xff,0xff,0xff,0xff,0xff,0xff,0xff,0xff,0xff,0xff,0xff,0xff,0xff,0xff,0xff,0xff,0xff,0xff,0xff,0xff,0xff,0xff,0xff,0xff,0xff,0xff,0xff,0xff,0xff,0xff,0xff,0xff,0xff,0xff,0xff,0xff,0xff,0xff,0xff,0xff,0xff,0xff,0xff,0xff,0xff,0xff,0xff,0xff,0xff,0xff,0xff,0xff,0xff,0xff,0xff,0xff,0xff,0xff,0xff,0xff,0xff,0xff,0xff,0xff,0xff,0xff,0xff,0xff,0xff,0xff,0xff,0xff,0xff,0xff,0xff,0xff,0xff,0xff,0xff,0xff,0xff,0xff,0xff,0xff,0xff,0xff,0xff,0xff,0xff,0xff,0xff,0xff,0xff,0xff,0xff";

// Array to hold the converted hex values
const int MAX_VALUES = 1024;  // Define a maximum size for the bitmap array
unsigned char hexArray[MAX_VALUES] = {0};  // Array to hold the final hex values

// Function to convert a single hex string to an unsigned char value
unsigned char hexToByte(String hex) {
  char cstr[3];
  Serial.print(hex);
  hex.toCharArray(cstr, 3);  // Convert String to C-style string
  return (unsigned char) strtoul(cstr, NULL, 16);  // Convert hex string to unsigned char
}

void setup() {
  Serial.begin(115200);

  // SSD1306_SWITCHCAPVCC = generate display voltage from 3.3V internally
  if(!display.begin(SSD1306_SWITCHCAPVCC, SCREEN_ADDRESS)) {
    Serial.println(F("SSD1306 allocation failed"));
    for(;;); // Don't proceed, loop forever
  }

  // Show initial display buffer contents on the screen --
  // the library initializes this with an Adafruit splash screen.
  display.display();
  delay(2000); // Pause for 2 seconds

  // Clear the buffer
  display.clearDisplay();


  // Split the hexString using commas
  int arrayIndex = 0;  // Array index for storing values
  int startIndex = 0;
  int endIndex = hexString.indexOf(',');  // Find first comma

  // Loop through and extract each hex value
  while (endIndex > 0 && arrayIndex < MAX_VALUES) {
    String hexValue = hexString.substring(startIndex + 2, endIndex);  // Skip the "0x" prefix
    hexArray[arrayIndex++] = hexToByte(hexValue);  // Convert and store in array
    startIndex = endIndex + 1;  // Move to the next character after comma
    endIndex = hexString.indexOf(',', startIndex);  // Find next comma
  }

  // For the last value (no comma after it)
  if (arrayIndex < MAX_VALUES) {
    String hexValue = hexString.substring(startIndex + 2);  // Skip the "0x" prefix
    hexArray[arrayIndex++] = hexToByte(hexValue);  // Convert and store in array
  }

  // Print out the final array
  Serial.println("Converted Hex Array:");
  Serial.print("const unsigned char bitmap[] = {");
  for (int i = 0; i < arrayIndex; i++) {
    Serial.print("0x");
    if (hexArray[i] < 0x10) Serial.print("0");  // For formatting (e.g., 0x01 instead of 0x1)
    Serial.print(hexArray[i], HEX);
    if (i < arrayIndex - 1) Serial.print(", ");
  }
  Serial.println("};");

  display.drawBitmap(0, 0, hexArray, 128, 64, 1);
  display.display();
}

void loop() {
  // No need to loop
}
